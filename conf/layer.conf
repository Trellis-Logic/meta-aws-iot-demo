## conf/layer.conf
```bitbake
# We have a conf and classes directory, add to BBPATH
BBPATH .= ":${LAYERDIR}"

# We have recipes-* directories, add to BBFILES
BBFILES += "${LAYERDIR}/recipes-*/*/*.bb \
            ${LAYERDIR}/recipes-*/*/*.bbappend"

BBFILES_DYNAMIC += "\
                    meta-rauc-raspberrypi:${LAYERDIR}/dynamic-layers/meta-rauc-raspberrypi/recipes-*/*/*.bb \
                    meta-rauc-raspberrypi:${LAYERDIR}/dynamic-layers/meta-rauc-raspberrypi/recipes-*/*/*.bbappend\
                    swupdate:${LAYERDIR}/dynamic-layers/meta-swupdate/recipes-*/*/*.bb \
                    swupdate:${LAYERDIR}/dynamic-layers/meta-swupdate/recipes-*/*/*.bbappend\
"

BBFILE_COLLECTIONS += "meta-aws-iot-demo"
BBFILE_PATTERN_meta-aws-iot-demo = "^${LAYERDIR}/"
BBFILE_PRIORITY_meta-aws-iot-demo = "10"

LAYERDEPENDS_meta-aws-iot-demo = "core meta-aws"
LAYERSERIES_COMPAT_meta-aws-iot-demo = "kirkstone nanbield scarthgap"
```
